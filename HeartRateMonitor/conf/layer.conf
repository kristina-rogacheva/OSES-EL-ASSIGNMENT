## HeartRateMonitor/conf/layer.conf
```bitbake
# We have a conf and classes directory, add to BBPATH
BBPATH .= ":${LAYERDIR}"

# We have recipes-* directories, add to BBFILES
BBFILES += "${LAYERDIR}/recipes-*/*/*.bb \
            ${LAYERDIR}/recipes-*/*/*.bbappend"

BBFILE_COLLECTIONS += "HeartRateMonitor"
BBFILE_PATTERN_HeartRateMonitor = "^${LAYERDIR}/"
BBFILE_PRIORITY_HeartRateMonitor = "6"

LAYERDEPENDS_HeartRateMonitor = "core"
LAYERSERIES_COMPAT_HeartRateMonitor = "dunfell"
```
